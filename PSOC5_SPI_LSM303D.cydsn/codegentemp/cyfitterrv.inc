    IF :LNOT::DEF:INCLUDED_CYFITTERRV_INC
INCLUDED_CYFITTERRV_INC EQU 1
    GET cydevicerv.inc
    GET cydevicerv_trm.inc

; Timer_1_TimerUDB
Timer_1_TimerUDB_nrstSts_stsreg__0__MASK EQU 0x01
Timer_1_TimerUDB_nrstSts_stsreg__0__POS EQU 0
Timer_1_TimerUDB_nrstSts_stsreg__16BIT_STATUS_AUX_CTL_REG EQU CYREG_B1_UDB05_06_ACTL
Timer_1_TimerUDB_nrstSts_stsreg__16BIT_STATUS_REG EQU CYREG_B1_UDB05_06_ST
Timer_1_TimerUDB_nrstSts_stsreg__2__MASK EQU 0x04
Timer_1_TimerUDB_nrstSts_stsreg__2__POS EQU 2
Timer_1_TimerUDB_nrstSts_stsreg__3__MASK EQU 0x08
Timer_1_TimerUDB_nrstSts_stsreg__3__POS EQU 3
Timer_1_TimerUDB_nrstSts_stsreg__MASK EQU 0x0D
Timer_1_TimerUDB_nrstSts_stsreg__MASK_REG EQU CYREG_B1_UDB05_MSK
Timer_1_TimerUDB_nrstSts_stsreg__STATUS_AUX_CTL_REG EQU CYREG_B1_UDB05_ACTL
Timer_1_TimerUDB_nrstSts_stsreg__STATUS_REG EQU CYREG_B1_UDB05_ST
Timer_1_TimerUDB_sCTRLReg_AsyncCtl_ctrlreg__16BIT_CONTROL_AUX_CTL_REG EQU CYREG_B1_UDB04_05_ACTL
Timer_1_TimerUDB_sCTRLReg_AsyncCtl_ctrlreg__16BIT_CONTROL_CONTROL_REG EQU CYREG_B1_UDB04_05_CTL
Timer_1_TimerUDB_sCTRLReg_AsyncCtl_ctrlreg__16BIT_CONTROL_COUNT_REG EQU CYREG_B1_UDB04_05_CTL
Timer_1_TimerUDB_sCTRLReg_AsyncCtl_ctrlreg__16BIT_COUNT_CONTROL_REG EQU CYREG_B1_UDB04_05_CTL
Timer_1_TimerUDB_sCTRLReg_AsyncCtl_ctrlreg__16BIT_COUNT_COUNT_REG EQU CYREG_B1_UDB04_05_CTL
Timer_1_TimerUDB_sCTRLReg_AsyncCtl_ctrlreg__16BIT_MASK_MASK_REG EQU CYREG_B1_UDB04_05_MSK
Timer_1_TimerUDB_sCTRLReg_AsyncCtl_ctrlreg__16BIT_MASK_PERIOD_REG EQU CYREG_B1_UDB04_05_MSK
Timer_1_TimerUDB_sCTRLReg_AsyncCtl_ctrlreg__16BIT_PERIOD_MASK_REG EQU CYREG_B1_UDB04_05_MSK
Timer_1_TimerUDB_sCTRLReg_AsyncCtl_ctrlreg__16BIT_PERIOD_PERIOD_REG EQU CYREG_B1_UDB04_05_MSK
Timer_1_TimerUDB_sCTRLReg_AsyncCtl_ctrlreg__7__MASK EQU 0x80
Timer_1_TimerUDB_sCTRLReg_AsyncCtl_ctrlreg__7__POS EQU 7
Timer_1_TimerUDB_sCTRLReg_AsyncCtl_ctrlreg__CONTROL_AUX_CTL_REG EQU CYREG_B1_UDB04_ACTL
Timer_1_TimerUDB_sCTRLReg_AsyncCtl_ctrlreg__CONTROL_REG EQU CYREG_B1_UDB04_CTL
Timer_1_TimerUDB_sCTRLReg_AsyncCtl_ctrlreg__CONTROL_ST_REG EQU CYREG_B1_UDB04_ST_CTL
Timer_1_TimerUDB_sCTRLReg_AsyncCtl_ctrlreg__COUNT_REG EQU CYREG_B1_UDB04_CTL
Timer_1_TimerUDB_sCTRLReg_AsyncCtl_ctrlreg__COUNT_ST_REG EQU CYREG_B1_UDB04_ST_CTL
Timer_1_TimerUDB_sCTRLReg_AsyncCtl_ctrlreg__MASK EQU 0x80
Timer_1_TimerUDB_sCTRLReg_AsyncCtl_ctrlreg__MASK_CTL_AUX_CTL_REG EQU CYREG_B1_UDB04_MSK_ACTL
Timer_1_TimerUDB_sCTRLReg_AsyncCtl_ctrlreg__PERIOD_REG EQU CYREG_B1_UDB04_MSK
Timer_1_TimerUDB_sCTRLReg_AsyncCtl_ctrlreg__PER_CTL_AUX_CTL_REG EQU CYREG_B1_UDB04_MSK_ACTL
Timer_1_TimerUDB_sT16_timerdp_u0__16BIT_A0_REG EQU CYREG_B1_UDB04_05_A0
Timer_1_TimerUDB_sT16_timerdp_u0__16BIT_A1_REG EQU CYREG_B1_UDB04_05_A1
Timer_1_TimerUDB_sT16_timerdp_u0__16BIT_D0_REG EQU CYREG_B1_UDB04_05_D0
Timer_1_TimerUDB_sT16_timerdp_u0__16BIT_D1_REG EQU CYREG_B1_UDB04_05_D1
Timer_1_TimerUDB_sT16_timerdp_u0__16BIT_DP_AUX_CTL_REG EQU CYREG_B1_UDB04_05_ACTL
Timer_1_TimerUDB_sT16_timerdp_u0__16BIT_F0_REG EQU CYREG_B1_UDB04_05_F0
Timer_1_TimerUDB_sT16_timerdp_u0__16BIT_F1_REG EQU CYREG_B1_UDB04_05_F1
Timer_1_TimerUDB_sT16_timerdp_u0__A0_A1_REG EQU CYREG_B1_UDB04_A0_A1
Timer_1_TimerUDB_sT16_timerdp_u0__A0_REG EQU CYREG_B1_UDB04_A0
Timer_1_TimerUDB_sT16_timerdp_u0__A1_REG EQU CYREG_B1_UDB04_A1
Timer_1_TimerUDB_sT16_timerdp_u0__D0_D1_REG EQU CYREG_B1_UDB04_D0_D1
Timer_1_TimerUDB_sT16_timerdp_u0__D0_REG EQU CYREG_B1_UDB04_D0
Timer_1_TimerUDB_sT16_timerdp_u0__D1_REG EQU CYREG_B1_UDB04_D1
Timer_1_TimerUDB_sT16_timerdp_u0__DP_AUX_CTL_REG EQU CYREG_B1_UDB04_ACTL
Timer_1_TimerUDB_sT16_timerdp_u0__F0_F1_REG EQU CYREG_B1_UDB04_F0_F1
Timer_1_TimerUDB_sT16_timerdp_u0__F0_REG EQU CYREG_B1_UDB04_F0
Timer_1_TimerUDB_sT16_timerdp_u0__F1_REG EQU CYREG_B1_UDB04_F1
Timer_1_TimerUDB_sT16_timerdp_u0__MSK_DP_AUX_CTL_REG EQU CYREG_B1_UDB04_MSK_ACTL
Timer_1_TimerUDB_sT16_timerdp_u0__PER_DP_AUX_CTL_REG EQU CYREG_B1_UDB04_MSK_ACTL
Timer_1_TimerUDB_sT16_timerdp_u1__16BIT_A0_REG EQU CYREG_B1_UDB05_06_A0
Timer_1_TimerUDB_sT16_timerdp_u1__16BIT_A1_REG EQU CYREG_B1_UDB05_06_A1
Timer_1_TimerUDB_sT16_timerdp_u1__16BIT_D0_REG EQU CYREG_B1_UDB05_06_D0
Timer_1_TimerUDB_sT16_timerdp_u1__16BIT_D1_REG EQU CYREG_B1_UDB05_06_D1
Timer_1_TimerUDB_sT16_timerdp_u1__16BIT_DP_AUX_CTL_REG EQU CYREG_B1_UDB05_06_ACTL
Timer_1_TimerUDB_sT16_timerdp_u1__16BIT_F0_REG EQU CYREG_B1_UDB05_06_F0
Timer_1_TimerUDB_sT16_timerdp_u1__16BIT_F1_REG EQU CYREG_B1_UDB05_06_F1
Timer_1_TimerUDB_sT16_timerdp_u1__A0_A1_REG EQU CYREG_B1_UDB05_A0_A1
Timer_1_TimerUDB_sT16_timerdp_u1__A0_REG EQU CYREG_B1_UDB05_A0
Timer_1_TimerUDB_sT16_timerdp_u1__A1_REG EQU CYREG_B1_UDB05_A1
Timer_1_TimerUDB_sT16_timerdp_u1__D0_D1_REG EQU CYREG_B1_UDB05_D0_D1
Timer_1_TimerUDB_sT16_timerdp_u1__D0_REG EQU CYREG_B1_UDB05_D0
Timer_1_TimerUDB_sT16_timerdp_u1__D1_REG EQU CYREG_B1_UDB05_D1
Timer_1_TimerUDB_sT16_timerdp_u1__DP_AUX_CTL_REG EQU CYREG_B1_UDB05_ACTL
Timer_1_TimerUDB_sT16_timerdp_u1__F0_F1_REG EQU CYREG_B1_UDB05_F0_F1
Timer_1_TimerUDB_sT16_timerdp_u1__F0_REG EQU CYREG_B1_UDB05_F0
Timer_1_TimerUDB_sT16_timerdp_u1__F1_REG EQU CYREG_B1_UDB05_F1

; SPIM_IntClock
SPIM_IntClock__CFG0 EQU CYREG_CLKDIST_DCFG0_CFG0
SPIM_IntClock__CFG1 EQU CYREG_CLKDIST_DCFG0_CFG1
SPIM_IntClock__CFG2 EQU CYREG_CLKDIST_DCFG0_CFG2
SPIM_IntClock__CFG2_SRC_SEL_MASK EQU 0x07
SPIM_IntClock__INDEX EQU 0x00
SPIM_IntClock__PM_ACT_CFG EQU CYREG_PM_ACT_CFG2
SPIM_IntClock__PM_ACT_MSK EQU 0x01
SPIM_IntClock__PM_STBY_CFG EQU CYREG_PM_STBY_CFG2
SPIM_IntClock__PM_STBY_MSK EQU 0x01

; UART_1_BUART
UART_1_BUART_sTX_TxShifter_u0__16BIT_A0_REG EQU CYREG_B0_UDB05_06_A0
UART_1_BUART_sTX_TxShifter_u0__16BIT_A1_REG EQU CYREG_B0_UDB05_06_A1
UART_1_BUART_sTX_TxShifter_u0__16BIT_D0_REG EQU CYREG_B0_UDB05_06_D0
UART_1_BUART_sTX_TxShifter_u0__16BIT_D1_REG EQU CYREG_B0_UDB05_06_D1
UART_1_BUART_sTX_TxShifter_u0__16BIT_DP_AUX_CTL_REG EQU CYREG_B0_UDB05_06_ACTL
UART_1_BUART_sTX_TxShifter_u0__16BIT_F0_REG EQU CYREG_B0_UDB05_06_F0
UART_1_BUART_sTX_TxShifter_u0__16BIT_F1_REG EQU CYREG_B0_UDB05_06_F1
UART_1_BUART_sTX_TxShifter_u0__A0_A1_REG EQU CYREG_B0_UDB05_A0_A1
UART_1_BUART_sTX_TxShifter_u0__A0_REG EQU CYREG_B0_UDB05_A0
UART_1_BUART_sTX_TxShifter_u0__A1_REG EQU CYREG_B0_UDB05_A1
UART_1_BUART_sTX_TxShifter_u0__D0_D1_REG EQU CYREG_B0_UDB05_D0_D1
UART_1_BUART_sTX_TxShifter_u0__D0_REG EQU CYREG_B0_UDB05_D0
UART_1_BUART_sTX_TxShifter_u0__D1_REG EQU CYREG_B0_UDB05_D1
UART_1_BUART_sTX_TxShifter_u0__DP_AUX_CTL_REG EQU CYREG_B0_UDB05_ACTL
UART_1_BUART_sTX_TxShifter_u0__F0_F1_REG EQU CYREG_B0_UDB05_F0_F1
UART_1_BUART_sTX_TxShifter_u0__F0_REG EQU CYREG_B0_UDB05_F0
UART_1_BUART_sTX_TxShifter_u0__F1_REG EQU CYREG_B0_UDB05_F1
UART_1_BUART_sTX_TxSts__0__MASK EQU 0x01
UART_1_BUART_sTX_TxSts__0__POS EQU 0
UART_1_BUART_sTX_TxSts__16BIT_STATUS_AUX_CTL_REG EQU CYREG_B0_UDB05_06_ACTL
UART_1_BUART_sTX_TxSts__16BIT_STATUS_REG EQU CYREG_B0_UDB05_06_ST
UART_1_BUART_sTX_TxSts__1__MASK EQU 0x02
UART_1_BUART_sTX_TxSts__1__POS EQU 1
UART_1_BUART_sTX_TxSts__2__MASK EQU 0x04
UART_1_BUART_sTX_TxSts__2__POS EQU 2
UART_1_BUART_sTX_TxSts__3__MASK EQU 0x08
UART_1_BUART_sTX_TxSts__3__POS EQU 3
UART_1_BUART_sTX_TxSts__MASK EQU 0x0F
UART_1_BUART_sTX_TxSts__MASK_REG EQU CYREG_B0_UDB05_MSK
UART_1_BUART_sTX_TxSts__STATUS_AUX_CTL_REG EQU CYREG_B0_UDB05_ACTL
UART_1_BUART_sTX_TxSts__STATUS_REG EQU CYREG_B0_UDB05_ST
UART_1_BUART_sTX_sCLOCK_TxBitClkGen__16BIT_A0_REG EQU CYREG_B0_UDB02_03_A0
UART_1_BUART_sTX_sCLOCK_TxBitClkGen__16BIT_A1_REG EQU CYREG_B0_UDB02_03_A1
UART_1_BUART_sTX_sCLOCK_TxBitClkGen__16BIT_D0_REG EQU CYREG_B0_UDB02_03_D0
UART_1_BUART_sTX_sCLOCK_TxBitClkGen__16BIT_D1_REG EQU CYREG_B0_UDB02_03_D1
UART_1_BUART_sTX_sCLOCK_TxBitClkGen__16BIT_DP_AUX_CTL_REG EQU CYREG_B0_UDB02_03_ACTL
UART_1_BUART_sTX_sCLOCK_TxBitClkGen__16BIT_F0_REG EQU CYREG_B0_UDB02_03_F0
UART_1_BUART_sTX_sCLOCK_TxBitClkGen__16BIT_F1_REG EQU CYREG_B0_UDB02_03_F1
UART_1_BUART_sTX_sCLOCK_TxBitClkGen__A0_A1_REG EQU CYREG_B0_UDB02_A0_A1
UART_1_BUART_sTX_sCLOCK_TxBitClkGen__A0_REG EQU CYREG_B0_UDB02_A0
UART_1_BUART_sTX_sCLOCK_TxBitClkGen__A1_REG EQU CYREG_B0_UDB02_A1
UART_1_BUART_sTX_sCLOCK_TxBitClkGen__D0_D1_REG EQU CYREG_B0_UDB02_D0_D1
UART_1_BUART_sTX_sCLOCK_TxBitClkGen__D0_REG EQU CYREG_B0_UDB02_D0
UART_1_BUART_sTX_sCLOCK_TxBitClkGen__D1_REG EQU CYREG_B0_UDB02_D1
UART_1_BUART_sTX_sCLOCK_TxBitClkGen__DP_AUX_CTL_REG EQU CYREG_B0_UDB02_ACTL
UART_1_BUART_sTX_sCLOCK_TxBitClkGen__F0_F1_REG EQU CYREG_B0_UDB02_F0_F1
UART_1_BUART_sTX_sCLOCK_TxBitClkGen__F0_REG EQU CYREG_B0_UDB02_F0
UART_1_BUART_sTX_sCLOCK_TxBitClkGen__F1_REG EQU CYREG_B0_UDB02_F1

; LCD_LCDPort
LCD_LCDPort__0__MASK EQU 0x01
LCD_LCDPort__0__PC EQU CYREG_PRT2_PC0
LCD_LCDPort__0__PORT EQU 2
LCD_LCDPort__0__SHIFT EQU 0
LCD_LCDPort__1__MASK EQU 0x02
LCD_LCDPort__1__PC EQU CYREG_PRT2_PC1
LCD_LCDPort__1__PORT EQU 2
LCD_LCDPort__1__SHIFT EQU 1
LCD_LCDPort__2__MASK EQU 0x04
LCD_LCDPort__2__PC EQU CYREG_PRT2_PC2
LCD_LCDPort__2__PORT EQU 2
LCD_LCDPort__2__SHIFT EQU 2
LCD_LCDPort__3__MASK EQU 0x08
LCD_LCDPort__3__PC EQU CYREG_PRT2_PC3
LCD_LCDPort__3__PORT EQU 2
LCD_LCDPort__3__SHIFT EQU 3
LCD_LCDPort__4__MASK EQU 0x10
LCD_LCDPort__4__PC EQU CYREG_PRT2_PC4
LCD_LCDPort__4__PORT EQU 2
LCD_LCDPort__4__SHIFT EQU 4
LCD_LCDPort__5__MASK EQU 0x20
LCD_LCDPort__5__PC EQU CYREG_PRT2_PC5
LCD_LCDPort__5__PORT EQU 2
LCD_LCDPort__5__SHIFT EQU 5
LCD_LCDPort__6__MASK EQU 0x40
LCD_LCDPort__6__PC EQU CYREG_PRT2_PC6
LCD_LCDPort__6__PORT EQU 2
LCD_LCDPort__6__SHIFT EQU 6
LCD_LCDPort__AG EQU CYREG_PRT2_AG
LCD_LCDPort__AMUX EQU CYREG_PRT2_AMUX
LCD_LCDPort__BIE EQU CYREG_PRT2_BIE
LCD_LCDPort__BIT_MASK EQU CYREG_PRT2_BIT_MASK
LCD_LCDPort__BYP EQU CYREG_PRT2_BYP
LCD_LCDPort__CTL EQU CYREG_PRT2_CTL
LCD_LCDPort__DM0 EQU CYREG_PRT2_DM0
LCD_LCDPort__DM1 EQU CYREG_PRT2_DM1
LCD_LCDPort__DM2 EQU CYREG_PRT2_DM2
LCD_LCDPort__DR EQU CYREG_PRT2_DR
LCD_LCDPort__INP_DIS EQU CYREG_PRT2_INP_DIS
LCD_LCDPort__LCD_COM_SEG EQU CYREG_PRT2_LCD_COM_SEG
LCD_LCDPort__LCD_EN EQU CYREG_PRT2_LCD_EN
LCD_LCDPort__MASK EQU 0x7F
LCD_LCDPort__PORT EQU 2
LCD_LCDPort__PRT EQU CYREG_PRT2_PRT
LCD_LCDPort__PRTDSI__CAPS_SEL EQU CYREG_PRT2_CAPS_SEL
LCD_LCDPort__PRTDSI__DBL_SYNC_IN EQU CYREG_PRT2_DBL_SYNC_IN
LCD_LCDPort__PRTDSI__OE_SEL0 EQU CYREG_PRT2_OE_SEL0
LCD_LCDPort__PRTDSI__OE_SEL1 EQU CYREG_PRT2_OE_SEL1
LCD_LCDPort__PRTDSI__OUT_SEL0 EQU CYREG_PRT2_OUT_SEL0
LCD_LCDPort__PRTDSI__OUT_SEL1 EQU CYREG_PRT2_OUT_SEL1
LCD_LCDPort__PRTDSI__SYNC_OUT EQU CYREG_PRT2_SYNC_OUT
LCD_LCDPort__PS EQU CYREG_PRT2_PS
LCD_LCDPort__SHIFT EQU 0
LCD_LCDPort__SLW EQU CYREG_PRT2_SLW

; m_miso_pin
m_miso_pin__0__MASK EQU 0x01
m_miso_pin__0__PC EQU CYREG_PRT0_PC0
m_miso_pin__0__PORT EQU 0
m_miso_pin__0__SHIFT EQU 0
m_miso_pin__AG EQU CYREG_PRT0_AG
m_miso_pin__AMUX EQU CYREG_PRT0_AMUX
m_miso_pin__BIE EQU CYREG_PRT0_BIE
m_miso_pin__BIT_MASK EQU CYREG_PRT0_BIT_MASK
m_miso_pin__BYP EQU CYREG_PRT0_BYP
m_miso_pin__CTL EQU CYREG_PRT0_CTL
m_miso_pin__DM0 EQU CYREG_PRT0_DM0
m_miso_pin__DM1 EQU CYREG_PRT0_DM1
m_miso_pin__DM2 EQU CYREG_PRT0_DM2
m_miso_pin__DR EQU CYREG_PRT0_DR
m_miso_pin__INP_DIS EQU CYREG_PRT0_INP_DIS
m_miso_pin__LCD_COM_SEG EQU CYREG_PRT0_LCD_COM_SEG
m_miso_pin__LCD_EN EQU CYREG_PRT0_LCD_EN
m_miso_pin__MASK EQU 0x01
m_miso_pin__PORT EQU 0
m_miso_pin__PRT EQU CYREG_PRT0_PRT
m_miso_pin__PRTDSI__CAPS_SEL EQU CYREG_PRT0_CAPS_SEL
m_miso_pin__PRTDSI__DBL_SYNC_IN EQU CYREG_PRT0_DBL_SYNC_IN
m_miso_pin__PRTDSI__OE_SEL0 EQU CYREG_PRT0_OE_SEL0
m_miso_pin__PRTDSI__OE_SEL1 EQU CYREG_PRT0_OE_SEL1
m_miso_pin__PRTDSI__OUT_SEL0 EQU CYREG_PRT0_OUT_SEL0
m_miso_pin__PRTDSI__OUT_SEL1 EQU CYREG_PRT0_OUT_SEL1
m_miso_pin__PRTDSI__SYNC_OUT EQU CYREG_PRT0_SYNC_OUT
m_miso_pin__PS EQU CYREG_PRT0_PS
m_miso_pin__SHIFT EQU 0
m_miso_pin__SLW EQU CYREG_PRT0_SLW

; m_mosi_pin
m_mosi_pin__0__MASK EQU 0x20
m_mosi_pin__0__PC EQU CYREG_PRT0_PC5
m_mosi_pin__0__PORT EQU 0
m_mosi_pin__0__SHIFT EQU 5
m_mosi_pin__AG EQU CYREG_PRT0_AG
m_mosi_pin__AMUX EQU CYREG_PRT0_AMUX
m_mosi_pin__BIE EQU CYREG_PRT0_BIE
m_mosi_pin__BIT_MASK EQU CYREG_PRT0_BIT_MASK
m_mosi_pin__BYP EQU CYREG_PRT0_BYP
m_mosi_pin__CTL EQU CYREG_PRT0_CTL
m_mosi_pin__DM0 EQU CYREG_PRT0_DM0
m_mosi_pin__DM1 EQU CYREG_PRT0_DM1
m_mosi_pin__DM2 EQU CYREG_PRT0_DM2
m_mosi_pin__DR EQU CYREG_PRT0_DR
m_mosi_pin__INP_DIS EQU CYREG_PRT0_INP_DIS
m_mosi_pin__LCD_COM_SEG EQU CYREG_PRT0_LCD_COM_SEG
m_mosi_pin__LCD_EN EQU CYREG_PRT0_LCD_EN
m_mosi_pin__MASK EQU 0x20
m_mosi_pin__PORT EQU 0
m_mosi_pin__PRT EQU CYREG_PRT0_PRT
m_mosi_pin__PRTDSI__CAPS_SEL EQU CYREG_PRT0_CAPS_SEL
m_mosi_pin__PRTDSI__DBL_SYNC_IN EQU CYREG_PRT0_DBL_SYNC_IN
m_mosi_pin__PRTDSI__OE_SEL0 EQU CYREG_PRT0_OE_SEL0
m_mosi_pin__PRTDSI__OE_SEL1 EQU CYREG_PRT0_OE_SEL1
m_mosi_pin__PRTDSI__OUT_SEL0 EQU CYREG_PRT0_OUT_SEL0
m_mosi_pin__PRTDSI__OUT_SEL1 EQU CYREG_PRT0_OUT_SEL1
m_mosi_pin__PRTDSI__SYNC_OUT EQU CYREG_PRT0_SYNC_OUT
m_mosi_pin__PS EQU CYREG_PRT0_PS
m_mosi_pin__SHIFT EQU 5
m_mosi_pin__SLW EQU CYREG_PRT0_SLW

; m_sclk_pin
m_sclk_pin__0__MASK EQU 0x40
m_sclk_pin__0__PC EQU CYREG_PRT0_PC6
m_sclk_pin__0__PORT EQU 0
m_sclk_pin__0__SHIFT EQU 6
m_sclk_pin__AG EQU CYREG_PRT0_AG
m_sclk_pin__AMUX EQU CYREG_PRT0_AMUX
m_sclk_pin__BIE EQU CYREG_PRT0_BIE
m_sclk_pin__BIT_MASK EQU CYREG_PRT0_BIT_MASK
m_sclk_pin__BYP EQU CYREG_PRT0_BYP
m_sclk_pin__CTL EQU CYREG_PRT0_CTL
m_sclk_pin__DM0 EQU CYREG_PRT0_DM0
m_sclk_pin__DM1 EQU CYREG_PRT0_DM1
m_sclk_pin__DM2 EQU CYREG_PRT0_DM2
m_sclk_pin__DR EQU CYREG_PRT0_DR
m_sclk_pin__INP_DIS EQU CYREG_PRT0_INP_DIS
m_sclk_pin__LCD_COM_SEG EQU CYREG_PRT0_LCD_COM_SEG
m_sclk_pin__LCD_EN EQU CYREG_PRT0_LCD_EN
m_sclk_pin__MASK EQU 0x40
m_sclk_pin__PORT EQU 0
m_sclk_pin__PRT EQU CYREG_PRT0_PRT
m_sclk_pin__PRTDSI__CAPS_SEL EQU CYREG_PRT0_CAPS_SEL
m_sclk_pin__PRTDSI__DBL_SYNC_IN EQU CYREG_PRT0_DBL_SYNC_IN
m_sclk_pin__PRTDSI__OE_SEL0 EQU CYREG_PRT0_OE_SEL0
m_sclk_pin__PRTDSI__OE_SEL1 EQU CYREG_PRT0_OE_SEL1
m_sclk_pin__PRTDSI__OUT_SEL0 EQU CYREG_PRT0_OUT_SEL0
m_sclk_pin__PRTDSI__OUT_SEL1 EQU CYREG_PRT0_OUT_SEL1
m_sclk_pin__PRTDSI__SYNC_OUT EQU CYREG_PRT0_SYNC_OUT
m_sclk_pin__PS EQU CYREG_PRT0_PS
m_sclk_pin__SHIFT EQU 6
m_sclk_pin__SLW EQU CYREG_PRT0_SLW

; SPIM_BSPIM
SPIM_BSPIM_BitCounter_ST__16BIT_STATUS_AUX_CTL_REG EQU CYREG_B0_UDB00_01_ACTL
SPIM_BSPIM_BitCounter_ST__16BIT_STATUS_REG EQU CYREG_B0_UDB00_01_ST
SPIM_BSPIM_BitCounter_ST__MASK_REG EQU CYREG_B0_UDB00_MSK
SPIM_BSPIM_BitCounter_ST__MASK_ST_AUX_CTL_REG EQU CYREG_B0_UDB00_MSK_ACTL
SPIM_BSPIM_BitCounter_ST__PER_ST_AUX_CTL_REG EQU CYREG_B0_UDB00_MSK_ACTL
SPIM_BSPIM_BitCounter_ST__STATUS_AUX_CTL_REG EQU CYREG_B0_UDB00_ACTL
SPIM_BSPIM_BitCounter_ST__STATUS_CNT_REG EQU CYREG_B0_UDB00_ST_CTL
SPIM_BSPIM_BitCounter_ST__STATUS_CONTROL_REG EQU CYREG_B0_UDB00_ST_CTL
SPIM_BSPIM_BitCounter_ST__STATUS_REG EQU CYREG_B0_UDB00_ST
SPIM_BSPIM_BitCounter__16BIT_CONTROL_AUX_CTL_REG EQU CYREG_B0_UDB00_01_ACTL
SPIM_BSPIM_BitCounter__16BIT_CONTROL_CONTROL_REG EQU CYREG_B0_UDB00_01_CTL
SPIM_BSPIM_BitCounter__16BIT_CONTROL_COUNT_REG EQU CYREG_B0_UDB00_01_CTL
SPIM_BSPIM_BitCounter__16BIT_COUNT_CONTROL_REG EQU CYREG_B0_UDB00_01_CTL
SPIM_BSPIM_BitCounter__16BIT_COUNT_COUNT_REG EQU CYREG_B0_UDB00_01_CTL
SPIM_BSPIM_BitCounter__16BIT_MASK_MASK_REG EQU CYREG_B0_UDB00_01_MSK
SPIM_BSPIM_BitCounter__16BIT_MASK_PERIOD_REG EQU CYREG_B0_UDB00_01_MSK
SPIM_BSPIM_BitCounter__16BIT_PERIOD_MASK_REG EQU CYREG_B0_UDB00_01_MSK
SPIM_BSPIM_BitCounter__16BIT_PERIOD_PERIOD_REG EQU CYREG_B0_UDB00_01_MSK
SPIM_BSPIM_BitCounter__CONTROL_AUX_CTL_REG EQU CYREG_B0_UDB00_ACTL
SPIM_BSPIM_BitCounter__CONTROL_REG EQU CYREG_B0_UDB00_CTL
SPIM_BSPIM_BitCounter__CONTROL_ST_REG EQU CYREG_B0_UDB00_ST_CTL
SPIM_BSPIM_BitCounter__COUNT_REG EQU CYREG_B0_UDB00_CTL
SPIM_BSPIM_BitCounter__COUNT_ST_REG EQU CYREG_B0_UDB00_ST_CTL
SPIM_BSPIM_BitCounter__MASK_CTL_AUX_CTL_REG EQU CYREG_B0_UDB00_MSK_ACTL
SPIM_BSPIM_BitCounter__PERIOD_REG EQU CYREG_B0_UDB00_MSK
SPIM_BSPIM_BitCounter__PER_CTL_AUX_CTL_REG EQU CYREG_B0_UDB00_MSK_ACTL
SPIM_BSPIM_RxStsReg__16BIT_STATUS_AUX_CTL_REG EQU CYREG_B0_UDB04_05_ACTL
SPIM_BSPIM_RxStsReg__16BIT_STATUS_REG EQU CYREG_B0_UDB04_05_ST
SPIM_BSPIM_RxStsReg__4__MASK EQU 0x10
SPIM_BSPIM_RxStsReg__4__POS EQU 4
SPIM_BSPIM_RxStsReg__5__MASK EQU 0x20
SPIM_BSPIM_RxStsReg__5__POS EQU 5
SPIM_BSPIM_RxStsReg__6__MASK EQU 0x40
SPIM_BSPIM_RxStsReg__6__POS EQU 6
SPIM_BSPIM_RxStsReg__MASK EQU 0x70
SPIM_BSPIM_RxStsReg__MASK_REG EQU CYREG_B0_UDB04_MSK
SPIM_BSPIM_RxStsReg__STATUS_AUX_CTL_REG EQU CYREG_B0_UDB04_ACTL
SPIM_BSPIM_RxStsReg__STATUS_REG EQU CYREG_B0_UDB04_ST
SPIM_BSPIM_TxStsReg__0__MASK EQU 0x01
SPIM_BSPIM_TxStsReg__0__POS EQU 0
SPIM_BSPIM_TxStsReg__16BIT_STATUS_AUX_CTL_REG EQU CYREG_B0_UDB03_04_ACTL
SPIM_BSPIM_TxStsReg__16BIT_STATUS_REG EQU CYREG_B0_UDB03_04_ST
SPIM_BSPIM_TxStsReg__1__MASK EQU 0x02
SPIM_BSPIM_TxStsReg__1__POS EQU 1
SPIM_BSPIM_TxStsReg__2__MASK EQU 0x04
SPIM_BSPIM_TxStsReg__2__POS EQU 2
SPIM_BSPIM_TxStsReg__3__MASK EQU 0x08
SPIM_BSPIM_TxStsReg__3__POS EQU 3
SPIM_BSPIM_TxStsReg__4__MASK EQU 0x10
SPIM_BSPIM_TxStsReg__4__POS EQU 4
SPIM_BSPIM_TxStsReg__MASK EQU 0x1F
SPIM_BSPIM_TxStsReg__MASK_REG EQU CYREG_B0_UDB03_MSK
SPIM_BSPIM_TxStsReg__MASK_ST_AUX_CTL_REG EQU CYREG_B0_UDB03_MSK_ACTL
SPIM_BSPIM_TxStsReg__PER_ST_AUX_CTL_REG EQU CYREG_B0_UDB03_MSK_ACTL
SPIM_BSPIM_TxStsReg__STATUS_AUX_CTL_REG EQU CYREG_B0_UDB03_ACTL
SPIM_BSPIM_TxStsReg__STATUS_CNT_REG EQU CYREG_B0_UDB03_ST_CTL
SPIM_BSPIM_TxStsReg__STATUS_CONTROL_REG EQU CYREG_B0_UDB03_ST_CTL
SPIM_BSPIM_TxStsReg__STATUS_REG EQU CYREG_B0_UDB03_ST
SPIM_BSPIM_sR8_Dp_u0__16BIT_A0_REG EQU CYREG_B0_UDB00_01_A0
SPIM_BSPIM_sR8_Dp_u0__16BIT_A1_REG EQU CYREG_B0_UDB00_01_A1
SPIM_BSPIM_sR8_Dp_u0__16BIT_D0_REG EQU CYREG_B0_UDB00_01_D0
SPIM_BSPIM_sR8_Dp_u0__16BIT_D1_REG EQU CYREG_B0_UDB00_01_D1
SPIM_BSPIM_sR8_Dp_u0__16BIT_DP_AUX_CTL_REG EQU CYREG_B0_UDB00_01_ACTL
SPIM_BSPIM_sR8_Dp_u0__16BIT_F0_REG EQU CYREG_B0_UDB00_01_F0
SPIM_BSPIM_sR8_Dp_u0__16BIT_F1_REG EQU CYREG_B0_UDB00_01_F1
SPIM_BSPIM_sR8_Dp_u0__A0_A1_REG EQU CYREG_B0_UDB00_A0_A1
SPIM_BSPIM_sR8_Dp_u0__A0_REG EQU CYREG_B0_UDB00_A0
SPIM_BSPIM_sR8_Dp_u0__A1_REG EQU CYREG_B0_UDB00_A1
SPIM_BSPIM_sR8_Dp_u0__D0_D1_REG EQU CYREG_B0_UDB00_D0_D1
SPIM_BSPIM_sR8_Dp_u0__D0_REG EQU CYREG_B0_UDB00_D0
SPIM_BSPIM_sR8_Dp_u0__D1_REG EQU CYREG_B0_UDB00_D1
SPIM_BSPIM_sR8_Dp_u0__DP_AUX_CTL_REG EQU CYREG_B0_UDB00_ACTL
SPIM_BSPIM_sR8_Dp_u0__F0_F1_REG EQU CYREG_B0_UDB00_F0_F1
SPIM_BSPIM_sR8_Dp_u0__F0_REG EQU CYREG_B0_UDB00_F0
SPIM_BSPIM_sR8_Dp_u0__F1_REG EQU CYREG_B0_UDB00_F1
SPIM_BSPIM_sR8_Dp_u0__MSK_DP_AUX_CTL_REG EQU CYREG_B0_UDB00_MSK_ACTL
SPIM_BSPIM_sR8_Dp_u0__PER_DP_AUX_CTL_REG EQU CYREG_B0_UDB00_MSK_ACTL

; Clock_1
Clock_1__CFG0 EQU CYREG_CLKDIST_DCFG1_CFG0
Clock_1__CFG1 EQU CYREG_CLKDIST_DCFG1_CFG1
Clock_1__CFG2 EQU CYREG_CLKDIST_DCFG1_CFG2
Clock_1__CFG2_SRC_SEL_MASK EQU 0x07
Clock_1__INDEX EQU 0x01
Clock_1__PM_ACT_CFG EQU CYREG_PM_ACT_CFG2
Clock_1__PM_ACT_MSK EQU 0x02
Clock_1__PM_STBY_CFG EQU CYREG_PM_STBY_CFG2
Clock_1__PM_STBY_MSK EQU 0x02

; Pin_1
Pin_1__0__MASK EQU 0x01
Pin_1__0__PC EQU CYREG_PRT3_PC0
Pin_1__0__PORT EQU 3
Pin_1__0__SHIFT EQU 0
Pin_1__AG EQU CYREG_PRT3_AG
Pin_1__AMUX EQU CYREG_PRT3_AMUX
Pin_1__BIE EQU CYREG_PRT3_BIE
Pin_1__BIT_MASK EQU CYREG_PRT3_BIT_MASK
Pin_1__BYP EQU CYREG_PRT3_BYP
Pin_1__CTL EQU CYREG_PRT3_CTL
Pin_1__DM0 EQU CYREG_PRT3_DM0
Pin_1__DM1 EQU CYREG_PRT3_DM1
Pin_1__DM2 EQU CYREG_PRT3_DM2
Pin_1__DR EQU CYREG_PRT3_DR
Pin_1__INP_DIS EQU CYREG_PRT3_INP_DIS
Pin_1__LCD_COM_SEG EQU CYREG_PRT3_LCD_COM_SEG
Pin_1__LCD_EN EQU CYREG_PRT3_LCD_EN
Pin_1__MASK EQU 0x01
Pin_1__PORT EQU 3
Pin_1__PRT EQU CYREG_PRT3_PRT
Pin_1__PRTDSI__CAPS_SEL EQU CYREG_PRT3_CAPS_SEL
Pin_1__PRTDSI__DBL_SYNC_IN EQU CYREG_PRT3_DBL_SYNC_IN
Pin_1__PRTDSI__OE_SEL0 EQU CYREG_PRT3_OE_SEL0
Pin_1__PRTDSI__OE_SEL1 EQU CYREG_PRT3_OE_SEL1
Pin_1__PRTDSI__OUT_SEL0 EQU CYREG_PRT3_OUT_SEL0
Pin_1__PRTDSI__OUT_SEL1 EQU CYREG_PRT3_OUT_SEL1
Pin_1__PRTDSI__SYNC_OUT EQU CYREG_PRT3_SYNC_OUT
Pin_1__PS EQU CYREG_PRT3_PS
Pin_1__SHIFT EQU 0
Pin_1__SLW EQU CYREG_PRT3_SLW

; Pin_2
Pin_2__0__MASK EQU 0x02
Pin_2__0__PC EQU CYREG_PRT3_PC1
Pin_2__0__PORT EQU 3
Pin_2__0__SHIFT EQU 1
Pin_2__AG EQU CYREG_PRT3_AG
Pin_2__AMUX EQU CYREG_PRT3_AMUX
Pin_2__BIE EQU CYREG_PRT3_BIE
Pin_2__BIT_MASK EQU CYREG_PRT3_BIT_MASK
Pin_2__BYP EQU CYREG_PRT3_BYP
Pin_2__CTL EQU CYREG_PRT3_CTL
Pin_2__DM0 EQU CYREG_PRT3_DM0
Pin_2__DM1 EQU CYREG_PRT3_DM1
Pin_2__DM2 EQU CYREG_PRT3_DM2
Pin_2__DR EQU CYREG_PRT3_DR
Pin_2__INP_DIS EQU CYREG_PRT3_INP_DIS
Pin_2__LCD_COM_SEG EQU CYREG_PRT3_LCD_COM_SEG
Pin_2__LCD_EN EQU CYREG_PRT3_LCD_EN
Pin_2__MASK EQU 0x02
Pin_2__PORT EQU 3
Pin_2__PRT EQU CYREG_PRT3_PRT
Pin_2__PRTDSI__CAPS_SEL EQU CYREG_PRT3_CAPS_SEL
Pin_2__PRTDSI__DBL_SYNC_IN EQU CYREG_PRT3_DBL_SYNC_IN
Pin_2__PRTDSI__OE_SEL0 EQU CYREG_PRT3_OE_SEL0
Pin_2__PRTDSI__OE_SEL1 EQU CYREG_PRT3_OE_SEL1
Pin_2__PRTDSI__OUT_SEL0 EQU CYREG_PRT3_OUT_SEL0
Pin_2__PRTDSI__OUT_SEL1 EQU CYREG_PRT3_OUT_SEL1
Pin_2__PRTDSI__SYNC_OUT EQU CYREG_PRT3_SYNC_OUT
Pin_2__PS EQU CYREG_PRT3_PS
Pin_2__SHIFT EQU 1
Pin_2__SLW EQU CYREG_PRT3_SLW

; Pin_3
Pin_3__0__MASK EQU 0x04
Pin_3__0__PC EQU CYREG_PRT3_PC2
Pin_3__0__PORT EQU 3
Pin_3__0__SHIFT EQU 2
Pin_3__AG EQU CYREG_PRT3_AG
Pin_3__AMUX EQU CYREG_PRT3_AMUX
Pin_3__BIE EQU CYREG_PRT3_BIE
Pin_3__BIT_MASK EQU CYREG_PRT3_BIT_MASK
Pin_3__BYP EQU CYREG_PRT3_BYP
Pin_3__CTL EQU CYREG_PRT3_CTL
Pin_3__DM0 EQU CYREG_PRT3_DM0
Pin_3__DM1 EQU CYREG_PRT3_DM1
Pin_3__DM2 EQU CYREG_PRT3_DM2
Pin_3__DR EQU CYREG_PRT3_DR
Pin_3__INP_DIS EQU CYREG_PRT3_INP_DIS
Pin_3__LCD_COM_SEG EQU CYREG_PRT3_LCD_COM_SEG
Pin_3__LCD_EN EQU CYREG_PRT3_LCD_EN
Pin_3__MASK EQU 0x04
Pin_3__PORT EQU 3
Pin_3__PRT EQU CYREG_PRT3_PRT
Pin_3__PRTDSI__CAPS_SEL EQU CYREG_PRT3_CAPS_SEL
Pin_3__PRTDSI__DBL_SYNC_IN EQU CYREG_PRT3_DBL_SYNC_IN
Pin_3__PRTDSI__OE_SEL0 EQU CYREG_PRT3_OE_SEL0
Pin_3__PRTDSI__OE_SEL1 EQU CYREG_PRT3_OE_SEL1
Pin_3__PRTDSI__OUT_SEL0 EQU CYREG_PRT3_OUT_SEL0
Pin_3__PRTDSI__OUT_SEL1 EQU CYREG_PRT3_OUT_SEL1
Pin_3__PRTDSI__SYNC_OUT EQU CYREG_PRT3_SYNC_OUT
Pin_3__PS EQU CYREG_PRT3_PS
Pin_3__SHIFT EQU 2
Pin_3__SLW EQU CYREG_PRT3_SLW

; Pin_4
Pin_4__0__MASK EQU 0x08
Pin_4__0__PC EQU CYREG_PRT3_PC3
Pin_4__0__PORT EQU 3
Pin_4__0__SHIFT EQU 3
Pin_4__AG EQU CYREG_PRT3_AG
Pin_4__AMUX EQU CYREG_PRT3_AMUX
Pin_4__BIE EQU CYREG_PRT3_BIE
Pin_4__BIT_MASK EQU CYREG_PRT3_BIT_MASK
Pin_4__BYP EQU CYREG_PRT3_BYP
Pin_4__CTL EQU CYREG_PRT3_CTL
Pin_4__DM0 EQU CYREG_PRT3_DM0
Pin_4__DM1 EQU CYREG_PRT3_DM1
Pin_4__DM2 EQU CYREG_PRT3_DM2
Pin_4__DR EQU CYREG_PRT3_DR
Pin_4__INP_DIS EQU CYREG_PRT3_INP_DIS
Pin_4__LCD_COM_SEG EQU CYREG_PRT3_LCD_COM_SEG
Pin_4__LCD_EN EQU CYREG_PRT3_LCD_EN
Pin_4__MASK EQU 0x08
Pin_4__PORT EQU 3
Pin_4__PRT EQU CYREG_PRT3_PRT
Pin_4__PRTDSI__CAPS_SEL EQU CYREG_PRT3_CAPS_SEL
Pin_4__PRTDSI__DBL_SYNC_IN EQU CYREG_PRT3_DBL_SYNC_IN
Pin_4__PRTDSI__OE_SEL0 EQU CYREG_PRT3_OE_SEL0
Pin_4__PRTDSI__OE_SEL1 EQU CYREG_PRT3_OE_SEL1
Pin_4__PRTDSI__OUT_SEL0 EQU CYREG_PRT3_OUT_SEL0
Pin_4__PRTDSI__OUT_SEL1 EQU CYREG_PRT3_OUT_SEL1
Pin_4__PRTDSI__SYNC_OUT EQU CYREG_PRT3_SYNC_OUT
Pin_4__PS EQU CYREG_PRT3_PS
Pin_4__SHIFT EQU 3
Pin_4__SLW EQU CYREG_PRT3_SLW

; Pin_5
Pin_5__0__MASK EQU 0x10
Pin_5__0__PC EQU CYREG_PRT3_PC4
Pin_5__0__PORT EQU 3
Pin_5__0__SHIFT EQU 4
Pin_5__AG EQU CYREG_PRT3_AG
Pin_5__AMUX EQU CYREG_PRT3_AMUX
Pin_5__BIE EQU CYREG_PRT3_BIE
Pin_5__BIT_MASK EQU CYREG_PRT3_BIT_MASK
Pin_5__BYP EQU CYREG_PRT3_BYP
Pin_5__CTL EQU CYREG_PRT3_CTL
Pin_5__DM0 EQU CYREG_PRT3_DM0
Pin_5__DM1 EQU CYREG_PRT3_DM1
Pin_5__DM2 EQU CYREG_PRT3_DM2
Pin_5__DR EQU CYREG_PRT3_DR
Pin_5__INP_DIS EQU CYREG_PRT3_INP_DIS
Pin_5__LCD_COM_SEG EQU CYREG_PRT3_LCD_COM_SEG
Pin_5__LCD_EN EQU CYREG_PRT3_LCD_EN
Pin_5__MASK EQU 0x10
Pin_5__PORT EQU 3
Pin_5__PRT EQU CYREG_PRT3_PRT
Pin_5__PRTDSI__CAPS_SEL EQU CYREG_PRT3_CAPS_SEL
Pin_5__PRTDSI__DBL_SYNC_IN EQU CYREG_PRT3_DBL_SYNC_IN
Pin_5__PRTDSI__OE_SEL0 EQU CYREG_PRT3_OE_SEL0
Pin_5__PRTDSI__OE_SEL1 EQU CYREG_PRT3_OE_SEL1
Pin_5__PRTDSI__OUT_SEL0 EQU CYREG_PRT3_OUT_SEL0
Pin_5__PRTDSI__OUT_SEL1 EQU CYREG_PRT3_OUT_SEL1
Pin_5__PRTDSI__SYNC_OUT EQU CYREG_PRT3_SYNC_OUT
Pin_5__PS EQU CYREG_PRT3_PS
Pin_5__SHIFT EQU 4
Pin_5__SLW EQU CYREG_PRT3_SLW

; Pin_6
Pin_6__0__MASK EQU 0x20
Pin_6__0__PC EQU CYREG_PRT3_PC5
Pin_6__0__PORT EQU 3
Pin_6__0__SHIFT EQU 5
Pin_6__AG EQU CYREG_PRT3_AG
Pin_6__AMUX EQU CYREG_PRT3_AMUX
Pin_6__BIE EQU CYREG_PRT3_BIE
Pin_6__BIT_MASK EQU CYREG_PRT3_BIT_MASK
Pin_6__BYP EQU CYREG_PRT3_BYP
Pin_6__CTL EQU CYREG_PRT3_CTL
Pin_6__DM0 EQU CYREG_PRT3_DM0
Pin_6__DM1 EQU CYREG_PRT3_DM1
Pin_6__DM2 EQU CYREG_PRT3_DM2
Pin_6__DR EQU CYREG_PRT3_DR
Pin_6__INP_DIS EQU CYREG_PRT3_INP_DIS
Pin_6__LCD_COM_SEG EQU CYREG_PRT3_LCD_COM_SEG
Pin_6__LCD_EN EQU CYREG_PRT3_LCD_EN
Pin_6__MASK EQU 0x20
Pin_6__PORT EQU 3
Pin_6__PRT EQU CYREG_PRT3_PRT
Pin_6__PRTDSI__CAPS_SEL EQU CYREG_PRT3_CAPS_SEL
Pin_6__PRTDSI__DBL_SYNC_IN EQU CYREG_PRT3_DBL_SYNC_IN
Pin_6__PRTDSI__OE_SEL0 EQU CYREG_PRT3_OE_SEL0
Pin_6__PRTDSI__OE_SEL1 EQU CYREG_PRT3_OE_SEL1
Pin_6__PRTDSI__OUT_SEL0 EQU CYREG_PRT3_OUT_SEL0
Pin_6__PRTDSI__OUT_SEL1 EQU CYREG_PRT3_OUT_SEL1
Pin_6__PRTDSI__SYNC_OUT EQU CYREG_PRT3_SYNC_OUT
Pin_6__PS EQU CYREG_PRT3_PS
Pin_6__SHIFT EQU 5
Pin_6__SLW EQU CYREG_PRT3_SLW

; Pin_7
Pin_7__0__MASK EQU 0x40
Pin_7__0__PC EQU CYREG_PRT3_PC6
Pin_7__0__PORT EQU 3
Pin_7__0__SHIFT EQU 6
Pin_7__AG EQU CYREG_PRT3_AG
Pin_7__AMUX EQU CYREG_PRT3_AMUX
Pin_7__BIE EQU CYREG_PRT3_BIE
Pin_7__BIT_MASK EQU CYREG_PRT3_BIT_MASK
Pin_7__BYP EQU CYREG_PRT3_BYP
Pin_7__CTL EQU CYREG_PRT3_CTL
Pin_7__DM0 EQU CYREG_PRT3_DM0
Pin_7__DM1 EQU CYREG_PRT3_DM1
Pin_7__DM2 EQU CYREG_PRT3_DM2
Pin_7__DR EQU CYREG_PRT3_DR
Pin_7__INP_DIS EQU CYREG_PRT3_INP_DIS
Pin_7__LCD_COM_SEG EQU CYREG_PRT3_LCD_COM_SEG
Pin_7__LCD_EN EQU CYREG_PRT3_LCD_EN
Pin_7__MASK EQU 0x40
Pin_7__PORT EQU 3
Pin_7__PRT EQU CYREG_PRT3_PRT
Pin_7__PRTDSI__CAPS_SEL EQU CYREG_PRT3_CAPS_SEL
Pin_7__PRTDSI__DBL_SYNC_IN EQU CYREG_PRT3_DBL_SYNC_IN
Pin_7__PRTDSI__OE_SEL0 EQU CYREG_PRT3_OE_SEL0
Pin_7__PRTDSI__OE_SEL1 EQU CYREG_PRT3_OE_SEL1
Pin_7__PRTDSI__OUT_SEL0 EQU CYREG_PRT3_OUT_SEL0
Pin_7__PRTDSI__OUT_SEL1 EQU CYREG_PRT3_OUT_SEL1
Pin_7__PRTDSI__SYNC_OUT EQU CYREG_PRT3_SYNC_OUT
Pin_7__PS EQU CYREG_PRT3_PS
Pin_7__SHIFT EQU 6
Pin_7__SLW EQU CYREG_PRT3_SLW

; Tx_1
Tx_1__0__MASK EQU 0x80
Tx_1__0__PC EQU CYREG_PRT3_PC7
Tx_1__0__PORT EQU 3
Tx_1__0__SHIFT EQU 7
Tx_1__AG EQU CYREG_PRT3_AG
Tx_1__AMUX EQU CYREG_PRT3_AMUX
Tx_1__BIE EQU CYREG_PRT3_BIE
Tx_1__BIT_MASK EQU CYREG_PRT3_BIT_MASK
Tx_1__BYP EQU CYREG_PRT3_BYP
Tx_1__CTL EQU CYREG_PRT3_CTL
Tx_1__DM0 EQU CYREG_PRT3_DM0
Tx_1__DM1 EQU CYREG_PRT3_DM1
Tx_1__DM2 EQU CYREG_PRT3_DM2
Tx_1__DR EQU CYREG_PRT3_DR
Tx_1__INP_DIS EQU CYREG_PRT3_INP_DIS
Tx_1__LCD_COM_SEG EQU CYREG_PRT3_LCD_COM_SEG
Tx_1__LCD_EN EQU CYREG_PRT3_LCD_EN
Tx_1__MASK EQU 0x80
Tx_1__PORT EQU 3
Tx_1__PRT EQU CYREG_PRT3_PRT
Tx_1__PRTDSI__CAPS_SEL EQU CYREG_PRT3_CAPS_SEL
Tx_1__PRTDSI__DBL_SYNC_IN EQU CYREG_PRT3_DBL_SYNC_IN
Tx_1__PRTDSI__OE_SEL0 EQU CYREG_PRT3_OE_SEL0
Tx_1__PRTDSI__OE_SEL1 EQU CYREG_PRT3_OE_SEL1
Tx_1__PRTDSI__OUT_SEL0 EQU CYREG_PRT3_OUT_SEL0
Tx_1__PRTDSI__OUT_SEL1 EQU CYREG_PRT3_OUT_SEL1
Tx_1__PRTDSI__SYNC_OUT EQU CYREG_PRT3_SYNC_OUT
Tx_1__PS EQU CYREG_PRT3_PS
Tx_1__SHIFT EQU 7
Tx_1__SLW EQU CYREG_PRT3_SLW

; SS
SS_Async_ctrl_reg__0__MASK EQU 0x01
SS_Async_ctrl_reg__0__POS EQU 0
SS_Async_ctrl_reg__16BIT_CONTROL_AUX_CTL_REG EQU CYREG_B0_UDB03_04_ACTL
SS_Async_ctrl_reg__16BIT_CONTROL_CONTROL_REG EQU CYREG_B0_UDB03_04_CTL
SS_Async_ctrl_reg__16BIT_CONTROL_COUNT_REG EQU CYREG_B0_UDB03_04_CTL
SS_Async_ctrl_reg__16BIT_COUNT_CONTROL_REG EQU CYREG_B0_UDB03_04_CTL
SS_Async_ctrl_reg__16BIT_COUNT_COUNT_REG EQU CYREG_B0_UDB03_04_CTL
SS_Async_ctrl_reg__16BIT_MASK_MASK_REG EQU CYREG_B0_UDB03_04_MSK
SS_Async_ctrl_reg__16BIT_MASK_PERIOD_REG EQU CYREG_B0_UDB03_04_MSK
SS_Async_ctrl_reg__16BIT_PERIOD_MASK_REG EQU CYREG_B0_UDB03_04_MSK
SS_Async_ctrl_reg__16BIT_PERIOD_PERIOD_REG EQU CYREG_B0_UDB03_04_MSK
SS_Async_ctrl_reg__1__MASK EQU 0x02
SS_Async_ctrl_reg__1__POS EQU 1
SS_Async_ctrl_reg__2__MASK EQU 0x04
SS_Async_ctrl_reg__2__POS EQU 2
SS_Async_ctrl_reg__CONTROL_AUX_CTL_REG EQU CYREG_B0_UDB03_ACTL
SS_Async_ctrl_reg__CONTROL_REG EQU CYREG_B0_UDB03_CTL
SS_Async_ctrl_reg__CONTROL_ST_REG EQU CYREG_B0_UDB03_ST_CTL
SS_Async_ctrl_reg__COUNT_REG EQU CYREG_B0_UDB03_CTL
SS_Async_ctrl_reg__COUNT_ST_REG EQU CYREG_B0_UDB03_ST_CTL
SS_Async_ctrl_reg__MASK EQU 0x07
SS_Async_ctrl_reg__MASK_CTL_AUX_CTL_REG EQU CYREG_B0_UDB03_MSK_ACTL
SS_Async_ctrl_reg__PERIOD_REG EQU CYREG_B0_UDB03_MSK
SS_Async_ctrl_reg__PER_CTL_AUX_CTL_REG EQU CYREG_B0_UDB03_MSK_ACTL

; Miscellaneous
; -- WARNING: define names containing LEOPARD or PANTHER are deprecated and will be removed in a future release
CYDEV_DEBUGGING_DPS_SWD_SWV EQU 6
CYDEV_CONFIG_UNUSED_IO_AllowButWarn EQU 0
CYDEV_CONFIGURATION_MODE_DMA EQU 2
CYDEV_CONFIG_FASTBOOT_ENABLED EQU 0
CYDEV_CHIP_REV_PANTHER_PRODUCTION EQU 1
CYDEV_CHIP_REVISION_5A_PRODUCTION EQU 1
CYDEV_CHIP_MEMBER_5A EQU 3
CYDEV_CHIP_FAMILY_PSOC5 EQU 3
CYDEV_CHIP_DIE_PANTHER EQU 3
CYDEV_CHIP_DIE_EXPECT EQU CYDEV_CHIP_DIE_PANTHER
BCLK__BUS_CLK__HZ EQU 24000000
BCLK__BUS_CLK__KHZ EQU 24000
BCLK__BUS_CLK__MHZ EQU 24
CYDEV_CHIP_DIE_ACTUAL EQU CYDEV_CHIP_DIE_EXPECT
CYDEV_CHIP_DIE_LEOPARD EQU 1
CYDEV_CHIP_DIE_PSOC4A EQU 2
CYDEV_CHIP_DIE_PSOC5LP EQU 4
CYDEV_CHIP_DIE_UNKNOWN EQU 0
CYDEV_CHIP_FAMILY_PSOC3 EQU 1
CYDEV_CHIP_FAMILY_PSOC4 EQU 2
CYDEV_CHIP_FAMILY_UNKNOWN EQU 0
CYDEV_CHIP_FAMILY_USED EQU CYDEV_CHIP_FAMILY_PSOC5
CYDEV_CHIP_JTAG_ID EQU 0x0E13C069
CYDEV_CHIP_MEMBER_3A EQU 1
CYDEV_CHIP_MEMBER_4A EQU 2
CYDEV_CHIP_MEMBER_5B EQU 4
CYDEV_CHIP_MEMBER_UNKNOWN EQU 0
CYDEV_CHIP_MEMBER_USED EQU CYDEV_CHIP_MEMBER_5A
CYDEV_CHIP_REVISION_3A_ES1 EQU 0
CYDEV_CHIP_REVISION_3A_ES2 EQU 1
CYDEV_CHIP_REVISION_3A_ES3 EQU 3
CYDEV_CHIP_REVISION_3A_PRODUCTION EQU 3
CYDEV_CHIP_REVISION_4A_ES0 EQU 17
CYDEV_CHIP_REVISION_4A_PRODUCTION EQU 17
CYDEV_CHIP_REVISION_5A_ES0 EQU 0
CYDEV_CHIP_REVISION_5A_ES1 EQU 1
CYDEV_CHIP_REVISION_5B_ES0 EQU 0
CYDEV_CHIP_REVISION_5B_PRODUCTION EQU 0
CYDEV_CHIP_REVISION_USED EQU CYDEV_CHIP_REVISION_5A_PRODUCTION
CYDEV_CHIP_REV_EXPECT EQU CYDEV_CHIP_REV_PANTHER_PRODUCTION
CYDEV_CHIP_REV_LEOPARD_ES1 EQU 0
CYDEV_CHIP_REV_LEOPARD_ES2 EQU 1
CYDEV_CHIP_REV_LEOPARD_ES3 EQU 3
CYDEV_CHIP_REV_LEOPARD_PRODUCTION EQU 3
CYDEV_CHIP_REV_PANTHER_ES0 EQU 0
CYDEV_CHIP_REV_PANTHER_ES1 EQU 1
CYDEV_CHIP_REV_PSOC4A_ES0 EQU 17
CYDEV_CHIP_REV_PSOC4A_PRODUCTION EQU 17
CYDEV_CHIP_REV_PSOC5LP_ES0 EQU 0
CYDEV_CHIP_REV_PSOC5LP_PRODUCTION EQU 0
CYDEV_CONFIGURATION_COMPRESSED EQU 0
CYDEV_CONFIGURATION_DMA EQU 1
CYDEV_CONFIGURATION_ECC EQU 1
CYDEV_CONFIGURATION_IMOENABLED EQU CYDEV_CONFIG_FASTBOOT_ENABLED
CYDEV_CONFIGURATION_MODE EQU CYDEV_CONFIGURATION_MODE_DMA
CYDEV_CONFIGURATION_MODE_COMPRESSED EQU 0
CYDEV_CONFIGURATION_MODE_UNCOMPRESSED EQU 1
CYDEV_CONFIG_UNUSED_IO EQU CYDEV_CONFIG_UNUSED_IO_AllowButWarn
CYDEV_CONFIG_UNUSED_IO_AllowWithInfo EQU 1
CYDEV_CONFIG_UNUSED_IO_Disallowed EQU 2
CYDEV_DATA_CACHE_ENABLED EQU 0
CYDEV_DEBUGGING_DPS EQU CYDEV_DEBUGGING_DPS_SWD_SWV
CYDEV_DEBUGGING_DPS_Disable EQU 3
CYDEV_DEBUGGING_ENABLE EQU 1
CYDEV_DEBUGGING_REQXRES EQU 1
CYDEV_DEBUGGING_XRES EQU 0
CYDEV_DEBUG_ENABLE_MASK EQU 0x01
CYDEV_DEBUG_ENABLE_REGISTER EQU CYREG_MLOGIC_DBG_DBE
CYDEV_DMA_CHANNELS_AVAILABLE EQU 24
CYDEV_ECC_ENABLE EQU 0
CYDEV_HEAP_SIZE EQU 0x1000
CYDEV_INSTRUCT_CACHE_ENABLED EQU 0
CYDEV_INTR_RISING EQU 0x00000000
CYDEV_PROJ_TYPE EQU 0
CYDEV_PROJ_TYPE_BOOTLOADER EQU 1
CYDEV_PROJ_TYPE_LOADABLE EQU 2
CYDEV_PROJ_TYPE_MULTIAPPBOOTLOADER EQU 3
CYDEV_PROJ_TYPE_STANDARD EQU 0
CYDEV_PROTECTION_ENABLE EQU 0
CYDEV_STACK_SIZE EQU 0x4000
CYDEV_USE_BUNDLED_CMSIS EQU 1
CYDEV_VDDA_MV EQU 3300
CYDEV_VDDD_MV EQU 3300
CYDEV_VDDIO0_MV EQU 3300
CYDEV_VDDIO1_MV EQU 3300
CYDEV_VDDIO2_MV EQU 3300
CYDEV_VDDIO3_MV EQU 3300
CYDEV_VIO0_MV EQU 3300
CYDEV_VIO1_MV EQU 3300
CYDEV_VIO2_MV EQU 3300
CYDEV_VIO3_MV EQU 3300
DMA_CHANNELS_USED__MASK0 EQU 0x00000000
CYDEV_BOOTLOADER_ENABLE EQU 0
    ENDIF
    END
